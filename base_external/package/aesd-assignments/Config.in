## base_external/package/aesd-assignments/Config.in
```kconfig
config BR2_PACKAGE_AESD_ASSIGNMENTS
    bool "aesd-assignments"
    help
      Build and install the AESD socket daemon (aesdsocket) and its
      startup script to the target filesystem.

      When selected, Buildroot will:
        - Clone your assignments repository at the specified commit.
        - Cross‑compile the server/aesdsocket program.
        - Install the aesdsocket binary to /usr/bin/.
        - Install the aesdsocket-start-stop script as
          /etc/init.d/S99aesdsocket for SysV init control.
```

## base_external/package/aesd-char-driver/Config.in
```kconfig
config BR2_PACKAGE_AESD_CHAR_DRIVER
    bool "aesd-char-driver"
    help
      Build and install the AESD Char Driver assignments
```

## base_external/package/ldd/Config.in
```kconfig
config BR2_PACKAGE_LDD
    bool "ldd"
    help
      Build and install the LDD assignments
```
